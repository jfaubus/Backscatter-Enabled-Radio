## CMakeLists.txt
```
cmake_minimum_required(VERSION 3.20)

# for global installs
find_package(Zephyr REQUIRED HINTS $ENV{ZEPHYR_BASE})

# populates the $PROJECT_NAME var and this is what the output files are named
project(capstone)

# app is a predesignated target that zephyr uses
target_sources(app PRIVATE
    src/main.c
    src/qspi_pattern.c
    src/hfxo.c
    src/ble_adv.c
)

target_include_directories(app PRIVATE ${CMAKE_CURRENT_SOURCE_DIR}/src)
```

## prj.conf
```kconfig
# --- Console / logging -------------------------------------------------------
CONFIG_SERIAL=y
CONFIG_CONSOLE=y
CONFIG_UART_CONSOLE=y
CONFIG_LOG=y
# Immediate mode: if bring-up hangs we still want the preceding lines out of
# the UART rather than stuck in a deferred log buffer.
CONFIG_LOG_MODE_IMMEDIATE=y

# --- nrfx drivers driven directly by the application -------------------------
CONFIG_NRFX_GPIOTE=y
CONFIG_NRFX_TIMER=y
CONFIG_NRFX_GPPI=y

# Zephyr's gpio_nrfx driver and ppi_fork.c both use nrfx_gpiote on the
# nRF52840's single GPIOTE instance. That is safe to share: nrfx tracks
# channel allocation in a module-global atomic mask (available_channels_mask
# in nrfx_gpiote.c) keyed by instance index, so both callers draw from the
# same pool of 8. Keep this on for sensors, SPI cs-gpios, LEDs and GPIO
# interrupts all need it.
CONFIG_GPIO=y

# TIMER's 16 MHz base needs the 32 MHz crystal to be accurate.
# ppi_fork_start() requests it explicitly via hfxo_request().
CONFIG_CLOCK_CONTROL=y
```

## boards/nrf52840dk_nrf52840.overlay
```dts
/*
 * nRF52840dk overlay for QSPI
 *
 *  QSPI is taken away from Zephyr and given to the application.
 *     Disabling the node removes both the nordic,qspi-nor flash driver and
 *     the mx25r64 child, so nrfx_qspi can own the peripheral outright. The
 *     pins are then selected at runtime (see src/qspi_pattern.c) onto the
 *     Arduino header instead of the onboard MX25R6435F, so the signals can
 *     be probed and so that each burst is not a real page program into the
 *     flash (wear, plus a WIP-busy stall between bursts).
 *			this is really more relevant on the dev kit which has an external
 *			flash hooked up to the QSPI bus
 *
 *     CONFIG_NRFX_QSPI only depends on the node *existing*, not on it being
 *     enabled, so disabling it here does not disable the nrfx driver.
 */

// disable this so I can drive the code directly through nrfx_qspi. sorry Zephyr...
&qspi {
	status = "disabled";
};


// &spi20 {
//     status = "okay";                                  /* Enable the SPI20 peripheral */
//     pinctrl-0 = <&spi20_default>;                      /* Required: default pin config */
//     pinctrl-names = "default";                         /* Only "default" needed if no sleep state */
//     cs-gpios = <&gpio2 5 GPIO_ACTIVE_LOW>;              /* Chip-select via GPIO2 pin 5, active-low */

//     sensor0: sensor@0 {
//         compatible = "vnd,spi-device";                 /* Binds node to a Zephyr driver binding */
//         reg = <0>;                                     /* Chip-select index 0 on this bus */
//         spi-max-frequency = <4000000>;                  /* Cap SPI clock at 4 MHz for this device */
//         label = "SENSOR0";                              /* Runtime name via device_get_binding() */
//     };
// };

/*
 * A child node does not inherit its parent's disabled status, so the flash
 * node has to be turned off by hand. Without this,
 * CONFIG_DT_HAS_NORDIC_QSPI_NOR_ENABLED stays set and simply enabling
 * CONFIG_FLASH later would silently instantiate a driver that fights us for
 * the peripheral
 */
&mx25r64 {
	status = "disabled";
};
```

## src/main.c
```c
/*
 * Capstone framework: nRF52840 DK
 *
 * QSPI driven directly by nrfx as a 4-bit-wide pattern generator at the
 * fastest clock the chip has (SCK up to 32 MHz off HFCLK128M).
 */

#include <zephyr/kernel.h>
#include <zephyr/logging/log.h>

#include "qspi_pattern.h"

LOG_MODULE_REGISTER(main, LOG_LEVEL_INF);

/* 256 bytes = 512 payload nibbles = 512 SCK clocks = 16 us at 32 MHz. */
#define QSPI_BURST_BYTES 256U

/*
 * A burst is only ~17 us long. At 500 ms between bursts the duty cycle is
 * 0.003%, which is miserable to trigger on. 10 ms gives 100 bursts/second --
 * still a clear idle gap between frames, but the scope stays lively.
 */
#define BURST_PERIOD_MS 10U

int main(void)
{
	int err;

	err = qspi_pattern_init(NRF_QSPI_FREQ_DIV1);
	if (err != 0) {
		LOG_ERR("QSPI pattern generator failed to start (%d)", err);
		return err;
	}

	// read from sensor
	// format advertising packet (ising ble_adv.c)
	// convert advertising packet to binary to switch pattern (using modulator.c)
	// generate the switch pattern using qspi_pattern.c

	LOG_INF("firing %u-byte bursts every %u ms", QSPI_BURST_BYTES, BURST_PERIOD_MS);

	while (true) {
		err = qspi_pattern_square(QSPI_BURST_BYTES);
		if (err != 0) {
			LOG_ERR("burst failed (%d)", err);
			return err;
		}

		// sleeps to await the next burst
		k_msleep(BURST_PERIOD_MS);
	}

	return 0;
}
```

## src/ble_adv.c
```c
#include "ble_adv.h"

#include <errno.h>
#include <string.h>

// Fixed access address for all advertising packets
#define ADV_ACCESS_ADDRESS 0x8E89BED6U

// Alternating 0101... whose first bit matches the access address LSB (0)
#define ADV_PREAMBLE 0xAAU

// PDU header byte 0: PDU type ADV_NONCONN_IND (0b0010), TxAdd = 1 (random)
#define ADV_PDU_TYPE_NONCONN_IND 0x02U
#define ADV_PDU_TXADD_RANDOM 0x40U

// The CRC register starts at 0x555555 for every advertising packet
#define ADV_CRC_INIT 0x555555U

/*
 * CRC-24, polynomial x^24 + x^10 + x^9 + x^6 + x^4 + x^3 + x + 1 (0x00065B).
 *
 * Data is fed in air order (LSB of each byte first), so the register is kept
 * bit-reversed: bit 0 here is the spec's position 23. That makes the result
 * come out ready to send LSB first which puts the spec's MSB on air first.
 */
static uint32_t crc24(const uint8_t *data, size_t len)
{
	// 0x555555 is 0xAAAAAA reversed (written this way to match the spec)
	uint32_t state = 0;

	for (unsigned int i = 0; i < 24U; i++) {
		if (ADV_CRC_INIT & (1U << i)) {
			state |= 1U << (23U - i);
		}
	}

	for (size_t i = 0; i < len; i++) {
		uint8_t byte = data[i];

		for (unsigned int j = 0; j < 8U; j++) {
			unsigned int fb = (state ^ byte) & 1U;

			byte >>= 1;
			state >>= 1;
			if (fb) {
				state ^= 0xDA6000U;
			}
		}
	}

	return state;
}

/*
 * Data whitening, polynomial x^7 + x^4 + 1. The spec seeds position 0 with 1
 * and positions 1..6 with the channel index, MSB at position 1. Here bit 6
 * is position 0 and bit 0 is position 6 (the output tap), so the seed is just
 * the channel index with bit 6 set.
 */
static void whiten(uint8_t *data, size_t len, uint8_t channel)
{
	uint8_t lfsr = (uint8_t)(channel | 0x40U);

	for (size_t i = 0; i < len; i++) {
		for (uint8_t m = 1U; m != 0U; m <<= 1) {
			if (lfsr & 0x01U) {
				lfsr ^= 0x88U;
				data[i] ^= m;
			}
			lfsr >>= 1;
		}
	}
}

int ble_adv_build(const uint8_t adv_addr[BLE_ADDR_LEN],
		  const uint8_t *adv_data, size_t adv_data_len,
		  uint8_t channel, uint8_t *out, size_t out_size)
{
	size_t pdu_len = 2U + BLE_ADDR_LEN + adv_data_len;
	size_t total = 1U + 4U + pdu_len + 3U;
	uint8_t *pdu = &out[5];
	uint32_t crc;
	size_t n = 0;

	if (channel < BLE_ADV_CHANNEL_37 || channel > BLE_ADV_CHANNEL_39 ||
	    adv_data_len > BLE_ADV_DATA_MAX ||
	    (adv_data_len > 0U && adv_data == NULL) || out_size < total) {
		return -EINVAL;
	}

	out[n++] = ADV_PREAMBLE;

	// Access address goes out least significant byte first
	for (unsigned int i = 0; i < 4U; i++) {
		out[n++] = (uint8_t)(ADV_ACCESS_ADDRESS >> (8U * i));
	}

	out[n++] = ADV_PDU_TYPE_NONCONN_IND | ADV_PDU_TXADD_RANDOM;
	out[n++] = (uint8_t)(BLE_ADDR_LEN + adv_data_len);

	memcpy(&out[n], adv_addr, BLE_ADDR_LEN);
	n += BLE_ADDR_LEN;

	if (adv_data_len > 0U) {
		memcpy(&out[n], adv_data, adv_data_len);
		n += adv_data_len;
	}

	crc = crc24(pdu, pdu_len);
	out[n++] = (uint8_t)crc;
	out[n++] = (uint8_t)(crc >> 8);
	out[n++] = (uint8_t)(crc >> 16);

	// Whitening covers the PDU and CRC, not the preamble or access address
	whiten(pdu, pdu_len + 3U, channel);

	return (int)n;
}

int ble_adv_hr_data(uint8_t bpm, uint8_t *out, size_t out_size)
{
	static const uint8_t name[] = { 'B', 'E', 'A', 'C', 'O', 'N' };
	size_t n = 0;

	if (out_size < 3U + (2U + sizeof(name)) + 6U) {
		return -EINVAL;
	}

	// Flags: LE General Discoverable, BR/EDR not supported
	out[n++] = 0x02;
	out[n++] = 0x01;
	out[n++] = 0x06;

	// Local Name
	out[n++] = (uint8_t)(1U + sizeof(name));
	out[n++] = 0x09;
	memcpy(&out[n], name, sizeof(name));
	n += sizeof(name);

	// Service Data, 16-bit UUID 0x180D (Heart Rate) little-endian
	out[n++] = 0x05;
	out[n++] = 0x16;
	out[n++] = 0x0D;
	out[n++] = 0x18;
	out[n++] = 0x00; // Heart Rate Measurement flags: uint8 BPM follows
	out[n++] = bpm;

	return (int)n;
}
```

## src/ble_adv.h
```c
/*
 * BLE advertising packet builder (LE 1M, legacy advertising).
 *
 * Produces the exact byte stream that goes on air
 * (ready for modulator.c)
 *
 *   preamble | access address | PDU header | AdvA | AdvData | CRC
 *     1 B          4 B             2 B        6 B   0-31 B    3 B
 *                            '---------- whitened ---------------'
 *
 * Bytes are in transmit order and each byte goes out LSB first
 * (Spec required)
 *
 * The PDU is ADV_NONCONN_IND: broadcast only, so the tag never has to
 * receive anything (because we can't receive anything on our pcb)
 *
 * no Zephyr dependencies in this file
 */

#ifndef BLE_ADV_H_
#define BLE_ADV_H_

#include <stddef.h>
#include <stdint.h>

// Advertising channel index so we can test multiple 
#define BLE_ADV_CHANNEL_37 37U // 2402 MHz
#define BLE_ADV_CHANNEL_38 38U // 2426 MHz
#define BLE_ADV_CHANNEL_39 39U // 2480 MHz

// Longest AdvData a legacy advertising PDU can carry 
// Legacy advertising = broadcaster can announce presence and send data
#define BLE_ADV_DATA_MAX 31U

// Preamble + access address + header + AdvA + max AdvData + CRC
#define BLE_ADV_PACKET_MAX (1U + 4U + 2U + 6U + BLE_ADV_DATA_MAX + 3U)

// Bytes in a BLE device address
#define BLE_ADDR_LEN 6U

/**
 * Build a whitened ADV_NONCONN_IND packet
 *
 * @param adv_addr     Advertiser address, least significant byte first
 *                     (the order it goes on air). Treated as a random
 *                     address, so a static one needs the top two bits of
 *                     adv_addr[5] set.
 * @param adv_data     AD structures (length, type, data...), or NULL if
 *                     @p adv_data_len is 0.
 * @param adv_data_len 0..BLE_ADV_DATA_MAX bytes.
 * @param channel      Advertising channel index the packet will be received
 *                     on (37, 38 or 39). Whitening depends on it, so a packet
 *                     built for one channel will not decode on another.
 * @param out          Output buffer.
 * @param out_size     Size of @p out; BLE_ADV_PACKET_MAX always suffices.
 *
 * @return Packet length in bytes (multiply by 8 for modulator_build()), or
 *         -EINVAL for a bad channel, oversized AdvData or a short buffer.
 */
int ble_adv_build(const uint8_t adv_addr[BLE_ADDR_LEN],
		  const uint8_t *adv_data, size_t adv_data_len,
		  uint8_t channel, uint8_t *out, size_t out_size);

/**
 * Fill in the AdvData for a heart-rate reading:
 *
 *   Flags                 02 01 06
 *   Complete Local Name   07 09 'B' 'E' 'A' 'C' 'O' 'N'
 *   Service Data (0x180D) 05 16 0D 18 00 <bpm>
 *
 * The service data payload follows the Heart Rate Measurement layout (a flags
 * byte of 0x00, meaning a uint8 BPM follows), so it reads naturally in tools
 * like nRF Connect. The name makes the tag easy to spot in a scan list.
 *
 * @return Number of AdvData bytes written, or -EINVAL if @p out_size is too
 *         small.
 */
int ble_adv_hr_data(uint8_t bpm, uint8_t *out, size_t out_size);

#endif /* BLE_ADV_H_ */
```

## src/hfxo.c
```c
#include "hfxo.h"

#include <zephyr/kernel.h>
#include <zephyr/device.h>
#include <zephyr/logging/log.h>
#include <zephyr/drivers/clock_control.h>

LOG_MODULE_REGISTER(hfxo, LOG_LEVEL_INF);

int hfxo_request(void)
{
	/* Each clock is its own clock-control device in current Zephyr. The
	 * older CLOCK_CONTROL_NRF_SUBSYS_HF enumerator on the parent "clock"
	 * node is deprecated and not compiled in on this tree.
	 */
	const struct device *clk = DEVICE_DT_GET(DT_NODELABEL(hfclk));
	int err;

	if (!device_is_ready(clk)) {
		LOG_ERR("hfclk device not ready");
		return -ENODEV;
	}

	/* clock_control_on() resolves to common_api_blocking_start() for this
	 * driver, so it returns only once the crystal has actually started.
	 */
	err = clock_control_on(clk, NULL);
	if (err == -EALREADY || err == -EINPROGRESS) {
		return 0;
	}

	if (err != 0) {
		LOG_ERR("HFXO request failed (%d)", err);
		return err;
	}

	LOG_INF("HFXO running; HFCLK is now crystal-accurate");

	return 0;
}
```

## src/hfxo.h
```c
/*
 * HFCLK source control.
 *
 * On reset the nRF52840 runs HFCLK from HFINT, an internal RC oscillator
 * accurate to only a few percent. Everything clocked from HFCLK inherits that
 * error -- TIMER's 16 MHz base, UARTE's baud rate.
 *
 * Nothing starts the 32 MHz crystal on its own here: Zephyr's system clock
 * runs off LFCLK/RTC, and no driver in this application sets
 * CONFIG_UART_NRFX_UARTE_HFXO_ON_ACTIVE. So any module whose *output
 * frequency* matters has to ask for the crystal itself.
 *
 * Requests are reference counted, so every such module should call this
 * rather than assume some other module already did.
 */

#ifndef HFXO_H_
#define HFXO_H_

/**
 * Start the 32 MHz crystal oscillator, or join an existing request, and block
 * until it is actually running (~300-400 us from cold).
 *
 * @return 0 on success, negative errno otherwise.
 */
int hfxo_request(void);

#endif /* HFXO_H_ */
```

## src/modulator.c
```c
#include "modulator.h"

#include <errno.h>

// Indexed by rotation state: 0 -> 120 -> 240 degrees
static const uint8_t phase_codes[3] = {
	MOD_CODE_PHASE_0,
	MOD_CODE_PHASE_120,
	MOD_CODE_PHASE_240,
};

// Nibbles are packed two per byte, high nibble first (it goes out first)
static void put_nibble(uint8_t *out, size_t n, uint8_t code)
{
	uint8_t nib = (uint8_t)(code << MOD_CODE_SHIFT) & 0x0FU;

	if ((n & 1U) == 0U) {
		out[n / 2U] = (uint8_t)(nib << 4);
	} else {
		out[n / 2U] |= nib;
	}
}

static size_t total_ticks(size_t nbits)
{
	size_t ticks = MOD_LEAD_IN_TICKS + nbits * MOD_TICKS_PER_BIT +
		       MOD_LEAD_OUT_TICKS;

	// 8 nibbles = 4 bytes
	return (ticks + 7U) & ~(size_t)7U;
}

size_t modulator_out_size(size_t nbits)
{
	return total_ticks(nbits) / 2U;
}

int modulator_build(const uint8_t *bits, size_t nbits,
		    uint8_t *out, size_t out_size)
{
	size_t total;
	size_t n = 0;
	unsigned int state = 0;
	unsigned int ticks_left;

	if (nbits == 0U || out_size < modulator_out_size(nbits)) {
		return -EINVAL;
	}

	total = total_ticks(nbits);

	while (n < MOD_LEAD_IN_TICKS) {
		put_nibble(out, n++, MOD_CODE_HARVEST);
	}

	// The first state takes its length from the first bit
	ticks_left = (bits[0] & 1U) ? MOD_TICKS_PER_STATE_ONE
				    : MOD_TICKS_PER_STATE_ZERO;

	for (size_t i = 0; i < nbits; i++) {
		unsigned int bit = (bits[i / 8U] >> (i % 8U)) & 1U;
		unsigned int state_len = bit ? MOD_TICKS_PER_STATE_ONE
					     : MOD_TICKS_PER_STATE_ZERO;

		for (unsigned int t = 0; t < MOD_TICKS_PER_BIT; t++) {
			put_nibble(out, n++, phase_codes[state]);

			if (--ticks_left == 0U) {
				state = (state + 1U) % 3U;
				ticks_left = state_len;
			}
		}
	}

	while (n < total) {
		put_nibble(out, n++, MOD_CODE_HARVEST);
	}

	return (int)(total / 2U);
}
```

## src/modulator.h
```c
/*
 * Bitstream -> SP4T switch-code sequence for SSB backscatter.
 *
 * The tag cannot make RF; it can only pick which of three reflect loads
 * (0, 120, 240 degrees) the antenna sees. Stepping 0 -> 1 -> 2 -> 0 rotates
 * the phase of the reflected carrier, which shifts it up in frequency by
 * SCK / (3 * ticks_per_state). BLE's GFSK is then just "rotate a bit faster"
 * for a 1 and "a bit slower" for a 0:
 *
 *   bit 1: 4 ticks per state -> 32 MHz / 12 = 2.667 MHz
 *   bit 0: 5 ticks per state -> 32 MHz / 15 = 2.133 MHz
 *
 * i.e. a 2.400 MHz shift with +/-267 kHz deviation (BLE allows a modulation
 * index of 0.45-0.55, roughly +/-225..275 kHz). With the receiver on channel
 * 38 (2426 MHz) the carrier has to sit at 2423.6 MHz.
 *
 * One tick is one QSPI SCK clock, i.e. one nibble on IO0..IO3. These numbers
 * only hold with SCK at 32 MHz (NRF_QSPI_FREQ_DIV1).
 *
 * This file has no Zephyr dependencies so it can be compiled and tested on a
 * host as-is.
 */

#ifndef MODULATOR_H_
#define MODULATOR_H_

#include <stddef.h>
#include <stdint.h>

/** QSPI SCK clocks per 1 us BLE bit at 32 MHz. */
#define MOD_TICKS_PER_BIT 32U

/** Switch-state lengths in ticks. See the frequency table above. */
#define MOD_TICKS_PER_STATE_ONE 4U
#define MOD_TICKS_PER_STATE_ZERO 5U

/*
 * SP4T control codes (V2:V1). The 0->120->240->0 cycle has to flip both bits
 * on one transition (11 -> 00), and the switch may pass through 10 or 01 on
 * the way. Putting harvest on 10 means a glitch there briefly absorbs rather
 * than reflecting the wrong phase -- at least half the time.
 *
 * PROVISIONAL: confirm against the PE42440 truth table and the board's load
 * assignment.
 */
#define MOD_CODE_PHASE_0 0x0U
#define MOD_CODE_PHASE_120 0x1U
#define MOD_CODE_PHASE_240 0x3U
#define MOD_CODE_HARVEST 0x2U

/*
 * Bit position of V1 inside the nibble. Each nibble drives IO3..IO0 (bit 3 on
 * IO3), so a shift of 2 puts V1 on IO2 (P1.07) and V2 on IO3 (P1.08). IO0
 * carries the QSPI opcode and IO1 is an input during the single-line phases,
 * so neither is usable for the switch.
 *
 * PROVISIONAL: assumes high-nibble-first, which is still unconfirmed.
 */
#define MOD_CODE_SHIFT 2U

/** Harvest-state nibbles emitted before the first bit. */
#define MOD_LEAD_IN_TICKS 8U

/**
 * Minimum harvest-state nibbles emitted after the last bit. More are added as
 * needed, because nrfx_qspi_write() requires a length that is a multiple of
 * 4 bytes.
 */
#define MOD_LEAD_OUT_TICKS 8U

/**
 * Output buffer size in bytes that modulator_build() needs for @p nbits bits:
 * about 16 bytes per bit (a full 376-bit advertising packet is ~6 KB).
 */
size_t modulator_out_size(size_t nbits);

/**
 * Turn a bitstream into a QSPI-ready switch-code buffer.
 *
 * @p bits is read in BLE on-air order: bit 0 of bits[0] goes out first, then
 * bit 1 of bits[0], and so on (LSB first within each byte). Phase runs
 * continuously across bit boundaries -- a state still running when a bit ends
 * finishes at its old length, and the new bit's rate applies from the next
 * state.
 *
 * The output starts and ends in the harvest state and is padded to a
 * multiple of 4 bytes, so it can be handed straight to qspi_pattern_burst().
 *
 * @param bits     Packed bitstream.
 * @param nbits    Number of bits to send.
 * @param out      Output buffer, at least modulator_out_size(nbits) bytes.
 * @param out_size Size of @p out in bytes.
 *
 * @return Number of bytes written, or -EINVAL if @p nbits is 0 or @p out is
 *         too small.
 */
int modulator_build(const uint8_t *bits, size_t nbits,
		    uint8_t *out, size_t out_size);

#endif /* MODULATOR_H_ */
```

## src/ppi_fork.c
```c
#include "ppi_fork.h"

#include <zephyr/kernel.h>
#include <zephyr/logging/log.h>

#include <nrfx_gpiote.h>
#include <nrfx_timer.h>
#include <helpers/nrfx_gppi.h>
#include <hal/nrf_gpio.h>

#include "hfxo.h"

LOG_MODULE_REGISTER(ppi_fork, LOG_LEVEL_INF);

/*
 *   		    Port    Role
 *   -------   ----    ----
 *   D8        P1.10   primary  (PPI channel TEP)
 *   D9        P1.11   fork     (PPI channel FORK.TEP)
 *
 * The two pins are given opposite initial states so the scope shows a
 * complementary pair (which also makes it obvious that both edges land on
 * the same clock rather than one lagging the other when we're testing)
 */
#define PIN_PRIMARY NRF_GPIO_PIN_MAP(1, 10)
#define PIN_FORK    NRF_GPIO_PIN_MAP(1, 11)

/* TIMER2: TIMER0 belongs to the Bluetooth controller if one is ever linked in,
 * and TIMER1 is a common default for other subsystems. (use timer 2 to be safe)
 */
static nrfx_timer_t timer = NRFX_TIMER_INSTANCE(NRF_TIMER2);

/* The nRF52840 has a single GPIOTE instance. CONFIG_GPIO is off so nothing
 * else is allocating out of it.
 */
static nrfx_gpiote_t gpiote = NRFX_GPIOTE_INSTANCE(NRF_GPIOTE);

static nrfx_gppi_handle_t gppi_h;
static uint8_t ch_primary;
static uint8_t ch_fork;
static bool running;

static int out_pin_configure(nrfx_gpiote_pin_t pin, uint8_t channel,
			     nrf_gpiote_outinit_t init_val)
{
	static const nrfx_gpiote_output_config_t output_config = {
		/* H0H1 keeps the edges clean at MHz rates into a scope probe. */
		// higher current for a cleaner edge (if there is overshoot change this)
		.drive = NRF_GPIO_PIN_H0H1,
		// the GPIOs are output only
		.input_connect = NRF_GPIO_PIN_INPUT_DISCONNECT,
		// already driven
		.pull = NRF_GPIO_PIN_NOPULL,
	};

	const nrfx_gpiote_task_config_t task_config = {
		// select channel from the 8 available
		.task_ch = channel,
		// determines what TASKS_OUT does
		.polarity = NRF_GPIOTE_POLARITY_TOGGLE,
		// initial gpio value
		.init_val = init_val,
	};

	// writes one register per pin allowing GPIOTE to drive
	return nrfx_gpiote_output_configure(&gpiote, pin, &output_config, &task_config);
}

int ppi_fork_start(uint32_t toggle_hz)
{
	uint32_t base_frequency;
	uint32_t ticks;
	int err;

	if (running) {
		return -EALREADY;
	}

	if (toggle_hz == 0U) {
		return -EINVAL;
	}

	/* TIMER's 16 MHz base comes from HFCLK; without the crystal the output
	 * inherits the RC oscillator's few-percent error (1 MHz read 970 kHz).
	 */
	err = hfxo_request();
	if (err != 0) {
		return err;
	}

	if (!nrfx_gpiote_init_check(&gpiote)) {
		err = nrfx_gpiote_init(&gpiote, NRFX_GPIOTE_DEFAULT_CONFIG_IRQ_PRIORITY);
		if (err != 0) {
			LOG_ERR("nrfx_gpiote_init failed (%d)", err);
			return err;
		}
	}

	// claim the channels
	err = nrfx_gpiote_channel_alloc(&gpiote, &ch_primary);
	if (err != 0) {
		LOG_ERR("no GPIOTE channel for the primary pin (%d)", err);
		return err;
	}

	// claim the channels
	err = nrfx_gpiote_channel_alloc(&gpiote, &ch_fork);
	if (err != 0) {
		LOG_ERR("no GPIOTE channel for the fork pin (%d)", err);
		goto free_primary_ch;
	}

	// bind pins
	err = out_pin_configure(PIN_PRIMARY, ch_primary, NRF_GPIOTE_INITIAL_VALUE_HIGH);
	if (err != 0) {
		LOG_ERR("primary pin configure failed (%d)", err);
		goto free_fork_ch;
	}

	err = out_pin_configure(PIN_FORK, ch_fork, NRF_GPIOTE_INITIAL_VALUE_LOW);
	if (err != 0) {
		LOG_ERR("fork pin configure failed (%d)", err);
		goto free_fork_ch;
	}

	// arms the tasks so TASKS_OUT[ch] @ 0x40006000 + 4ch becomes live 
	// writing 1 here toggles the pin
	nrfx_gpiote_out_task_enable(&gpiote, PIN_PRIMARY);
	nrfx_gpiote_out_task_enable(&gpiote, PIN_FORK);


	// set up the timer
	// MODE      @ 0x4000A504  = Timer     (count PCLK16M, not external pulses)
	// BITMODE   @ 0x4000A508  = 32-bit
	// PRESCALER @ 0x4000A510  = 0         (16 MHz / 2^0)
	// CC[0]     @ 0x4000A540  = ticks
	// SHORTS    @ 0x4000A200  = COMPARE0_CLEAR
	base_frequency = NRF_TIMER_BASE_FREQUENCY_GET(timer.p_reg);  //16 MHz

	// prescaler is 0 so full 16 MHz no division
	nrfx_timer_config_t timer_config = NRFX_TIMER_DEFAULT_CONFIG(base_frequency);

	timer_config.bit_width = NRF_TIMER_BIT_WIDTH_32;

	/* NULL handler: the timer never raises an interrupt. The whole point of
	 * the exercise is that the CPU is not involved once this is armed.
	 */
	err = nrfx_timer_init(&timer, &timer_config, NULL);
	if (err != 0) {
		LOG_ERR("nrfx_timer_init failed (%d)", err);
		goto disable_tasks;
	}

	nrfx_timer_clear(&timer);

	/* Two compare events per output period, since each one toggles. */
	// one output period costs two events
	ticks = base_frequency / (2U * toggle_hz);
	if (ticks < 2U) {
		ticks = 2U;
	}

	/* COMPARE0_CLEAR turns CC0 into a free-running period; enable_int is
	 * false so no NVIC line is ever asserted. (INTENSET is never written)
	 */
	nrfx_timer_extended_compare(&timer, NRF_TIMER_CC_CHANNEL0, ticks,
				    NRF_TIMER_SHORT_COMPARE0_CLEAR_MASK, false);

	/* EEP = TIMER2 COMPARE[0], TEP = GPIOTE OUT task for the primary pin. */
	err = nrfx_gppi_conn_alloc(
		nrfx_timer_compare_event_address_get(&timer, NRF_TIMER_CC_CHANNEL0),
		nrfx_gpiote_out_task_address_get(&gpiote, PIN_PRIMARY),
		&gppi_h);
	if (err != 0) {
		LOG_ERR("no PPI channel available (%d)", err);
		goto uninit_timer;
	}

	/* Second task endpoint on the same channel. On PPI hardware nrfx puts
	 * this in FORK.TEP because TEP is already taken; on DPPI parts the same
	 * call just subscribes another task to the channel. That is the whole
	 * reason for going through nrfx_gppi rather than nrf_ppi directly.
	 */
	err = nrfx_gppi_ep_attach(nrfx_gpiote_out_task_address_get(&gpiote, PIN_FORK), gppi_h);
	if (err != 0) {
		LOG_ERR("fork endpoint attach failed (%d)", err);
		goto free_conn;
	}

	nrfx_gppi_conn_enable(gppi_h);
	nrfx_timer_enable(&timer);

	running = true;

	LOG_INF("PPI fork running: P1.10 and P1.11 toggling at %u Hz "
		"(TIMER2 %u Hz, CC0 = %u ticks), CPU idle",
		base_frequency / (2U * ticks), base_frequency, ticks);

	return 0;

free_conn:
	nrfx_gppi_conn_free(
		nrfx_timer_compare_event_address_get(&timer, NRF_TIMER_CC_CHANNEL0),
		nrfx_gpiote_out_task_address_get(&gpiote, PIN_PRIMARY),
		gppi_h);
uninit_timer:
	nrfx_timer_uninit(&timer);
disable_tasks:
	nrfx_gpiote_out_task_disable(&gpiote, PIN_PRIMARY);
	nrfx_gpiote_out_task_disable(&gpiote, PIN_FORK);
	(void)nrfx_gpiote_pin_uninit(&gpiote, PIN_PRIMARY);
	(void)nrfx_gpiote_pin_uninit(&gpiote, PIN_FORK);
free_fork_ch:
	(void)nrfx_gpiote_channel_free(&gpiote, ch_fork);
free_primary_ch:
	(void)nrfx_gpiote_channel_free(&gpiote, ch_primary);

	return err;
}

void ppi_fork_stop(void)
{
	if (!running) {
		return;
	}

	nrfx_timer_disable(&timer);
	nrfx_gppi_conn_disable(gppi_h);
	nrfx_gppi_conn_free(
		nrfx_timer_compare_event_address_get(&timer, NRF_TIMER_CC_CHANNEL0),
		nrfx_gpiote_out_task_address_get(&gpiote, PIN_PRIMARY),
		gppi_h);
	nrfx_timer_uninit(&timer);

	nrfx_gpiote_out_task_disable(&gpiote, PIN_PRIMARY);
	nrfx_gpiote_out_task_disable(&gpiote, PIN_FORK);
	(void)nrfx_gpiote_pin_uninit(&gpiote, PIN_PRIMARY);
	(void)nrfx_gpiote_pin_uninit(&gpiote, PIN_FORK);
	(void)nrfx_gpiote_channel_free(&gpiote, ch_fork);
	(void)nrfx_gpiote_channel_free(&gpiote, ch_primary);

	running = false;
}
```

## src/ppi_fork.h
```c
/*
 * One TIMER event -> PPI channel + its fork -> two GPIOTE tasks.
 *
 * A PPI channel on the nRF52 series has three endpoint registers: EEP (the
 * event), TEP (the task) and FORK.TEP (a second task). Both task endpoints
 * fire from the same event in the same clock cycle, so the two pins transition
 * together with no software in the path at all -- no interrupt, no jitter, and
 * it keeps running while the CPU is busy or asleep.
 */

#ifndef PPI_FORK_H_
#define PPI_FORK_H_

#include <stdint.h>

/**
 * Start toggling both pins at @p toggle_hz.
 *
 * The TIMER runs at 16 MHz and each compare event toggles the pins, so one
 * output period costs two events and the ceiling is 4 MHz (ticks >= 2).
 *
 * @return 0 on success, negative errno otherwise.
 */
int ppi_fork_start(uint32_t toggle_hz);

/** Stop the timer and release the PPI channel and both GPIOTE channels. */
void ppi_fork_stop(void);

#endif /* PPI_FORK_H_ */
```

## src/qspi_pattern.c
```c
#include "qspi_pattern.h"

#include <string.h>

#include <zephyr/kernel.h>
#include <zephyr/logging/log.h>

#include <nrfx_qspi.h>
#include <hal/nrf_gpio.h>

#include "hfxo.h"

LOG_MODULE_REGISTER(qspi_pattern, LOG_LEVEL_INF);

/*
 * Pin map. These are NOT the DK's QSPI flash pins (P0.17/19/20-23). The
 * nRF52840 QSPI has independent PSEL registers for every signal, so the block
 * is moved onto six adjacent, otherwise-unused Arduino header pins:
 *
 *   Arduino   Port    QSPI signal
 *   -------   ----    -----------
 *   D2        P1.03   SCK
 *   D3        P1.04   CSN
 *   D4        P1.05   IO0
 *   D5        P1.06   IO1
 *   D6        P1.07   IO2
 *   D7        P1.08   IO3
 */
#define QSPI_PIN_SCK NRF_GPIO_PIN_MAP(1, 3)
#define QSPI_PIN_CSN NRF_GPIO_PIN_MAP(1, 4)
#define QSPI_PIN_IO0 NRF_GPIO_PIN_MAP(1, 5)
#define QSPI_PIN_IO1 NRF_GPIO_PIN_MAP(1, 6)
#define QSPI_PIN_IO2 NRF_GPIO_PIN_MAP(1, 7)
#define QSPI_PIN_IO3 NRF_GPIO_PIN_MAP(1, 8)

/* The peripheral polls the (nonexistent) memory during ACTIVATE. Fail fast
 * instead of sitting in nrfx's wait loop for half a second.
 */
#define QSPI_ACTIVATE_TIMEOUT_MS 20

/* QSPI DMA reads the source through the EasyDMA port: the buffer has to live
 * in Data RAM and be word-aligned.
 */
static uint8_t pattern_buf[QSPI_PATTERN_MAX_BURST] __aligned(4);

static bool initialised;

uint32_t qspi_pattern_sck_hz(nrf_qspi_frequency_t sck_div)
{
	/* SCK is derived from a fixed 32 MHz source: SCK = 32 MHz / (DIV + 1),
	 * where the enum value is the divider minus one.
	 */
	return 32000000U / ((uint32_t)sck_div + 1U);
}

static void qspi_config_fill(nrfx_qspi_config_t *cfg, nrf_qspi_frequency_t sck_div)
{
	*cfg = (nrfx_qspi_config_t)NRFX_QSPI_DEFAULT_CONFIG(
		QSPI_PIN_SCK, QSPI_PIN_CSN,
		QSPI_PIN_IO0, QSPI_PIN_IO1,
		QSPI_PIN_IO2, QSPI_PIN_IO3);

	/* PP4IO (opcode 0x38): the opcode goes out on IO0 alone, then address
	 * and payload are shifted four bits per clock across IO0..IO3. That is
	 * what makes this a 4-bit-wide pattern generator rather than a serial
	 * one.
	 */
	cfg->prot_if.writeoc = NRF_QSPI_WRITEOC_PP4IO;
	cfg->prot_if.readoc = NRF_QSPI_READOC_READ4IO;
	cfg->prot_if.addrmode = NRF_QSPI_ADDRMODE_24BIT;

	cfg->phy_if.sck_freq = sck_div;
	cfg->phy_if.spi_mode = NRF_QSPI_MODE_0;
	/* Minimum CSN-to-SCK dead time; nothing on the bus needs setup time. */
	cfg->phy_if.sck_delay = 0;

	cfg->timeout = QSPI_ACTIVATE_TIMEOUT_MS;
}

/*
 * nrfx configures every QSPI pin with NRF_GPIO_PIN_NOPULL. That is correct
 * with a real memory attached, but here nothing drives IO1. During ACTIVATE
 * the peripheral issues a status-register read and waits for the memory's
 * WIP bit to clear; a floating IO1 that settles high reads WIP=1 forever and
 * activation returns -ETIMEDOUT. Pulling IO1 down makes the status byte read
 * back 0x00, so activation completes.
 *
 * The pull is applied after nrfx_qspi_init() because init overwrites PIN_CNF.
 * (Strapping P1.06 to GND on the header has the same effect in hardware.)
 * 
 * Basically there's no external flash pulling this line down saying "hey
 * Im ready" so were configuring it so that it constantly reads as "ready"
 */
static void qspi_idle_pulldown_apply(void)
{
	nrf_gpio_cfg(QSPI_PIN_IO1,
		     NRF_GPIO_PIN_DIR_INPUT,
		     NRF_GPIO_PIN_INPUT_DISCONNECT,
		     NRF_GPIO_PIN_PULLDOWN,
		     NRF_GPIO_PIN_H0H1,
		     NRF_GPIO_PIN_NOSENSE);
}

int qspi_pattern_init(nrf_qspi_frequency_t sck_div)
{
	nrfx_qspi_config_t cfg;
	int err;

	if (initialised) {
		return qspi_pattern_set_freq(sck_div);
	}

	/* QSPI is clocked from HFCLK128M; without the crystal its SCK would
	 * inherit the RC oscillator's few-percent error.
	 */
	err = hfxo_request();
	if (err != 0) {
		return err;
	}

	qspi_config_fill(&cfg, sck_div);

	// writes settings into the QSPI hardware registers and sets the pins up  w/ high drive no pull
	err = nrfx_qspi_init(&cfg, NULL /* blocking mode */, NULL);
	if (err != 0 && err != -EALREADY) {
		LOG_ERR("nrfx_qspi_init failed (%d)", err);
		return err;
	}

	qspi_idle_pulldown_apply();

	// sends "read status register 0x05" adnd listens on I01 (configured to mock flash chip response)
	// with I01 forver pulled down it should always read "ready" and activation succeeds
	err = nrfx_qspi_activate(true);
	if (err != 0 && err != -EALREADY) {
		LOG_ERR("nrfx_qspi_activate failed (%d)", err);
		if (err == -ETIMEDOUT) {
			LOG_ERR("  ACTIVATE polls a status register that nothing "
				"answers. Try strapping IO1 (P1.06) to GND.");
		}
		nrfx_qspi_uninit();
		return err;
	}

	initialised = true;

	LOG_INF("QSPI pattern generator up: SCK %u Hz on P1.03, "
		"IO0..IO3 on P1.05..P1.08, CSN on P1.04",
		qspi_pattern_sck_hz(sck_div));

	return 0;
}

int qspi_pattern_set_freq(nrf_qspi_frequency_t sck_div)
{
	nrfx_qspi_config_t cfg;
	int err;

	if (!initialised) {
		return -EPERM;
	}

	qspi_config_fill(&cfg, sck_div);

	/* reconfigure() deactivates the peripheral, so the pull-down has to be
	 * reapplied before the next activation for the same reason as at init.
	 */
	err = nrfx_qspi_reconfigure(&cfg);
	if (err != 0) {
		LOG_ERR("nrfx_qspi_reconfigure failed (%d)", err);
		return err;
	}

	qspi_idle_pulldown_apply();

	err = nrfx_qspi_activate(true);
	if (err != 0 && err != -EALREADY) {
		LOG_ERR("reactivation failed (%d)", err);
		return err;
	}

	LOG_INF("SCK now %u Hz", qspi_pattern_sck_hz(sck_div));

	return 0;
}

int qspi_pattern_burst(const void *data, size_t len)
{
	if (!initialised) {
		return -EPERM;
	}

	if (len == 0U || len > sizeof(pattern_buf)) {
		return -EINVAL;
	}

	memcpy(pattern_buf, data, len);

	/*
	 * One call produces two CSN frames on the wire, not one: the QSPI
	 * peripheral automatically prepends a WREN (0x06) before every page
	 * program. The pattern frame itself is
	 *
	 *   CSN low | 0x38 on IO0 (8 clocks) | 24-bit address (6 clocks, quad)
	 *           | len*2 payload nibbles  | CSN high
	 *
	 * so on a scope the payload starts 14 SCK clocks after CSN falls on the
	 * second frame. The destination address is meaningless here (nothing is
	 * listening) and is left at 0.
	 */
	return nrfx_qspi_write(pattern_buf, len, 0);
}

int qspi_pattern_fill_burst(uint8_t byte, size_t len)
{
	if (!initialised) {
		return -EPERM;
	}

	if (len == 0U || len > sizeof(pattern_buf)) {
		return -EINVAL;
	}

	// fills the ram buffer
	memset(pattern_buf, byte, len);

	// write these 256 bytes to flash address 0 and the CPU waits while the hardware the rest
	// by DMA (remember it is not actually writing to Flash)
	return nrfx_qspi_write(pattern_buf, len, 0);
}

int qspi_pattern_square(size_t len)
{
	/*
	 * In quad mode each byte is two nibbles, MSB nibble first, and each
	 * nibble drives IO3..IO0 for one SCK clock. 0xF0 therefore drives all
	 * four lines high for one clock and low for the next: a square wave at
	 * SCK/2 on every IO line simultaneously, 16 MHz with SCK at 32 MHz.
	 */
	return qspi_pattern_fill_burst(0xF0, len);
}

void qspi_pattern_stop(void)
{
	if (!initialised) {
		return;
	}

	nrfx_qspi_uninit();
	initialised = false;
}
```

## src/qspi_pattern.h
```c
/*
 * QSPI as a high-speed digital pattern generator on the nRF52840.
 *
 * The QSPI peripheral is clocked from HFCLK128M and can drive SCK at up to
 * 32 MHz -- faster than anything the CPU can reach by writing OUTSET/OUTCLR,
 * and faster than SPIM (8 MHz) or PWM. In quad ("4IO") mode it shifts four
 * bits per SCK clock out of IO0..IO3, so a RAM buffer becomes an arbitrary
 * 4-bit-wide waveform at up to 32 Mbit/s per line.
 *
 * There is no memory device on the bus: the pins are mapped onto the Arduino
 * header, not the DK's onboard MX25R6435F. See the pin table in
 * qspi_pattern.c.
 */

#ifndef QSPI_PATTERN_H_
#define QSPI_PATTERN_H_

#include <stddef.h>
#include <stdint.h>

#include <hal/nrf_qspi.h>

/** Largest burst a single qspi_pattern_burst() call can emit. */
#define QSPI_PATTERN_MAX_BURST 8192U

/**
 * Bring up QSPI as a pattern generator.
 *
 * @param sck_div SCK prescaler. SCK = 32 MHz / (sck_div + 1), so
 *                NRF_QSPI_FREQ_DIV1 is the 32 MHz maximum.
 *
 * @return 0 on success, negative errno otherwise. -ETIMEDOUT means the
 *         peripheral never reported READY after ACTIVATE; see the comment on
 *         the IO1 pull-down in qspi_pattern.c.
 */
int qspi_pattern_init(nrf_qspi_frequency_t sck_div);

/** Change SCK on the fly. Same return codes as qspi_pattern_init(). */
int qspi_pattern_set_freq(nrf_qspi_frequency_t sck_div);

/** Resulting SCK in Hz for a given prescaler, for logging and sanity checks. */
uint32_t qspi_pattern_sck_hz(nrf_qspi_frequency_t sck_div);

/**
 * Emit one CSN-framed burst of @p len bytes from @p data.
 *
 * The bytes are copied into an internal word-aligned RAM buffer first, so
 * @p data may live anywhere (including flash).
 *
 * @return 0 on success, -EINVAL for a bad length, -EPERM if not initialised,
 *         otherwise whatever nrfx_qspi_write() returned.
 */
int qspi_pattern_burst(const void *data, size_t len);

/** Emit @p len bytes all equal to @p byte. */
int qspi_pattern_fill_burst(uint8_t byte, size_t len);

/**
 * Emit the fastest square wave the peripheral can produce: every IO line
 * toggles on every SCK clock, i.e. SCK/2 on IO0..IO3.
 */
int qspi_pattern_square(size_t len);

/** Release the peripheral and return the pins to their reset state. */
void qspi_pattern_stop(void);

#endif /* QSPI_PATTERN_H_ */
```

## src/radio_raw.c
```c
#include "radio_raw.h"

#include <errno.h>
#include <string.h>

#include <nrfx.h>

#include "hfxo.h"

// Advertising access address, split the way the RADIO wants it
#define ADV_AA_PREFIX 0x8EU    // most significant byte
#define ADV_AA_BASE 0x89BED6U  // lower three bytes
#define ADV_AA_BASE_LEN 3U

#define ADV_CRC_POLY 0x00065BU
#define ADV_CRC_INIT 0x555555U

// The RADIO reads the packet over EasyDMA, so it has to live in RAM
static uint8_t tx_buf[255];

static bool initialised;
static bool control_mode;

// RF frequency as an offset from 2400 MHz
static int channel_to_freq(uint8_t channel)
{
	switch (channel) {
	case 37:
		return 2;
	case 38:
		return 26;
	case 39:
		return 80;
	default:
		return -EINVAL;
	}
}

int radio_raw_init(uint8_t channel, bool hw_crc)
{
	int freq = channel_to_freq(channel);
	int err;

	if (freq < 0) {
		return freq;
	}

	err = hfxo_request();
	if (err != 0) {
		return err;
	}

	NRF_RADIO->POWER = 1;
	NRF_RADIO->MODE = RADIO_MODE_MODE_Ble_1Mbit;
	NRF_RADIO->TXPOWER = RADIO_TXPOWER_TXPOWER_0dBm;
	NRF_RADIO->FREQUENCY = (uint32_t)freq;

	// Logical address 0 = 0x8E89BED6. BASE0 is left-aligned in the register
	NRF_RADIO->PREFIX0 = ADV_AA_PREFIX;
	NRF_RADIO->BASE0 = ADV_AA_BASE << 8;
	NRF_RADIO->TXADDRESS = 0;

	if (hw_crc) {
		/*
		 * Standard BLE layout: S0 = header byte 0, LENGTH = header byte 1,
		 * then the payload. The radio appends the CRC and whitens.
		 */
		NRF_RADIO->PCNF0 = (8UL << RADIO_PCNF0_LFLEN_Pos) |
				   (1UL << RADIO_PCNF0_S0LEN_Pos) |
				   (RADIO_PCNF0_PLEN_8bit << RADIO_PCNF0_PLEN_Pos);
		NRF_RADIO->PCNF1 = (255UL << RADIO_PCNF1_MAXLEN_Pos) |
				   (ADV_AA_BASE_LEN << RADIO_PCNF1_BALEN_Pos) |
				   (RADIO_PCNF1_ENDIAN_Little << RADIO_PCNF1_ENDIAN_Pos) |
				   (1UL << RADIO_PCNF1_WHITEEN_Pos);
		NRF_RADIO->CRCCNF = (RADIO_CRCCNF_LEN_Three << RADIO_CRCCNF_LEN_Pos) |
				    (RADIO_CRCCNF_SKIPADDR_Skip << RADIO_CRCCNF_SKIPADDR_Pos);
		NRF_RADIO->CRCPOLY = ADV_CRC_POLY;
		NRF_RADIO->CRCINIT = ADV_CRC_INIT;
		NRF_RADIO->DATAWHITEIV = channel;
	} else {
		/*
		 * No S0, no LENGTH field, no CRC, no whitening: every byte is
		 * static payload and goes out exactly as given. STATLEN is set
		 * per packet in radio_raw_send().
		 */
		NRF_RADIO->PCNF0 = (RADIO_PCNF0_PLEN_8bit << RADIO_PCNF0_PLEN_Pos);
		NRF_RADIO->CRCCNF = RADIO_CRCCNF_LEN_Disabled << RADIO_CRCCNF_LEN_Pos;
	}

	NRF_RADIO->PACKETPTR = (uint32_t)tx_buf;

	// Ramp up -> send -> disable, with no CPU involvement in between
	NRF_RADIO->SHORTS = RADIO_SHORTS_READY_START_Msk |
			    RADIO_SHORTS_END_DISABLE_Msk;

	control_mode = hw_crc;
	initialised = true;

	return 0;
}

int radio_raw_send(const uint8_t *pdu, size_t len)
{
	if (!initialised) {
		return -EPERM;
	}

	if (len == 0U || len > sizeof(tx_buf)) {
		return -EINVAL;
	}

	memcpy(tx_buf, pdu, len);

	if (!control_mode) {
		NRF_RADIO->PCNF1 = ((uint32_t)len << RADIO_PCNF1_MAXLEN_Pos) |
				   ((uint32_t)len << RADIO_PCNF1_STATLEN_Pos) |
				   (ADV_AA_BASE_LEN << RADIO_PCNF1_BALEN_Pos) |
				   (RADIO_PCNF1_ENDIAN_Little << RADIO_PCNF1_ENDIAN_Pos);
	}

	NRF_RADIO->EVENTS_DISABLED = 0;
	NRF_RADIO->TASKS_TXEN = 1;

	while (NRF_RADIO->EVENTS_DISABLED == 0) {
	}

	return 0;
}
```

## src/radio_raw.h
```c
/*
 * Bare-metal BLE 1M transmitter on the nRF52840 RADIO peripheral, for
 * checking ble_adv_build() output against a real receiver (a phone running
 * nRF Connect). Zephyr's Bluetooth stack is deliberately not used: it would
 * build its own packets and the test would prove nothing about ours.
 *
 * Two modes:
 *
 *   raw      Hardware CRC and whitening OFF. The radio sends our bytes
 *            verbatim after its own preamble and access address, so the
 *            phone only sees the packet if ble_adv_build()'s CRC and
 *            whitening are right. This is the actual test.
 *
 *   control  Hardware CRC and whitening ON, fed an un-whitened PDU. If the
 *            phone sees this but not raw mode, the radio setup is fine and
 *            the bug is in ble_adv.c.
 *
 * The RADIO needs the 32 MHz crystal; radio_raw_init() requests it.
 */

#ifndef RADIO_RAW_H_
#define RADIO_RAW_H_

#include <stdbool.h>
#include <stddef.h>
#include <stdint.h>

/**
 * Configure the RADIO for BLE 1M advertising on one channel.
 *
 * @param channel Advertising channel index: 37, 38 or 39.
 * @param hw_crc  false for raw mode, true for control mode (see above).
 *
 * @return 0 on success, -EINVAL for a bad channel, otherwise whatever
 *         hfxo_request() returned.
 */
int radio_raw_init(uint8_t channel, bool hw_crc);

/**
 * Transmit one packet and block until it is out (~300 us).
 *
 * @param pdu Raw mode: ble_adv_build() output from the PDU header onward
 *            (header, AdvA, AdvData, CRC -- whitened). Control mode: the
 *            un-whitened header + AdvA + AdvData, no CRC.
 * @param len Bytes in @p pdu, at most 255.
 *
 * @return 0 on success, -EPERM if not initialised, -EINVAL for a bad length.
 */
int radio_raw_send(const uint8_t *pdu, size_t len);

#endif /* RADIO_RAW_H_ */
```
